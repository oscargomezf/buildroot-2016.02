## configs/tedpi_2b_flea3_defconfig
```kconfig
BR2_arm=y
BR2_cortex_a7=y
BR2_ARM_FPU_NEON_VFPV4=y
BR2_PRIMARY_SITE="http://buildroot.tedesys.net"
BR2_PACKAGE_HOST_LINUX_HEADERS_CUSTOM_4_1=y
BR2_TOOLCHAIN_BUILDROOT_GLIBC=y
BR2_TOOLCHAIN_BUILDROOT_CXX=y
BR2_TARGET_GENERIC_HOSTNAME="tedpi"
BR2_TARGET_GENERIC_ISSUE="Welcome to Buildroot 2016.02 by Tedesys"
BR2_TARGET_GENERIC_PASSWD_SHA512=y
BR2_ROOTFS_DEVICE_CREATION_DYNAMIC_EUDEV=y
BR2_TARGET_GENERIC_ROOT_PASSWD="tedpi"
BR2_TARGET_GENERIC_GETTY_PORT="ttyAMA0"
BR2_SYSTEM_DHCP="eth0"
BR2_ROOTFS_POST_IMAGE_SCRIPT="board/tedesys/tedpi-2b-flea3/post-image.sh"
BR2_LINUX_KERNEL=y
BR2_LINUX_KERNEL_CUSTOM_GIT=y
BR2_LINUX_KERNEL_CUSTOM_REPO_URL="https://github.com/raspberrypi/linux.git"
BR2_LINUX_KERNEL_CUSTOM_REPO_VERSION="d33d0293e245badc4ca6ede3984d8bb8ea63cb1a"
BR2_LINUX_KERNEL_PATCH="$(TOPDIR)/board/tedesys/tedpi-2b-flea3/linux-patches  "
BR2_LINUX_KERNEL_DEFCONFIG="bcm2709"
BR2_LINUX_KERNEL_ZIMAGE=y
BR2_PACKAGE_BUSYBOX_WATCHDOG=y
BR2_PACKAGE_WIRINGPI=y
BR2_PACKAGE_FLYCAPTURE2_ARM_LIB=y
BR2_PACKAGE_FLYCAPTURE_ENABLE_PASSWORD=y
BR2_PACKAGE_FLYCAPTURE2_ARM_SNAPSHOT=y
BR2_PACKAGE_RPI_FIRMWARE=y
BR2_PACKAGE_RPI_FIRMWARE_INSTALL_VCDBG=y
BR2_PACKAGE_I2C_TOOLS=y
BR2_PACKAGE_DROPBEAR=y
BR2_PACKAGE_NTP=y
BR2_PACKAGE_NANO=y
BR2_TARGET_ROOTFS_EXT2=y
BR2_TARGET_ROOTFS_EXT2_4=y
BR2_PACKAGE_HOST_DOSFSTOOLS=y
BR2_PACKAGE_HOST_GENIMAGE=y
BR2_PACKAGE_HOST_MTOOLS=y
```

## configs/tedpi_2b_x_defconfig
```kconfig
BR2_arm=y
BR2_cortex_a7=y
BR2_ARM_FPU_NEON_VFPV4=y
BR2_PRIMARY_SITE="http://buildroot.tedesys.net"
BR2_PACKAGE_HOST_LINUX_HEADERS_CUSTOM_4_1=y
BR2_TOOLCHAIN_BUILDROOT_GLIBC=y
BR2_TOOLCHAIN_BUILDROOT_CXX=y
BR2_TARGET_GENERIC_HOSTNAME="tedpi"
BR2_TARGET_GENERIC_ISSUE="Welcome to Buildroot 2016.02 by Tedesys"
BR2_TARGET_GENERIC_PASSWD_SHA512=y
BR2_ROOTFS_DEVICE_CREATION_DYNAMIC_EUDEV=y
BR2_TARGET_GENERIC_ROOT_PASSWD="tedpi"
BR2_TARGET_GENERIC_GETTY_PORT="ttyAMA0"
BR2_SYSTEM_DHCP="eth0"
BR2_ROOTFS_POST_BUILD_SCRIPT="$(TOPDIR)/board/tedesys/tedpi/post-build.sh"
BR2_ROOTFS_POST_IMAGE_SCRIPT="$(TOPDIR)/board/tedesys/tedpi/post-image.sh"
BR2_ROOTFS_POST_SCRIPT_ARGS="tedpi-2b-x"
BR2_LINUX_KERNEL=y
BR2_LINUX_KERNEL_CUSTOM_GIT=y
BR2_LINUX_KERNEL_CUSTOM_REPO_URL="https://github.com/raspberrypi/linux.git"
BR2_LINUX_KERNEL_CUSTOM_REPO_VERSION="20fe468af4bb40fec0f81753da4b20a8bfc259c9"
BR2_LINUX_KERNEL_DEFCONFIG="bcm2709"
BR2_LINUX_KERNEL_ZIMAGE=y
BR2_LINUX_KERNEL_DTS_SUPPORT=y
BR2_LINUX_KERNEL_INTREE_DTS_NAME="bcm2709-rpi-2-b"
BR2_PACKAGE_BUSYBOX_WATCHDOG=y
BR2_PACKAGE_ALSA_UTILS=y
BR2_PACKAGE_ALSA_UTILS_ALSACONF=y
BR2_PACKAGE_ALSA_UTILS_ACONNECT=y
BR2_PACKAGE_ALSA_UTILS_AMIXER=y
BR2_PACKAGE_GSTREAMER1=y
BR2_PACKAGE_GST1_PLUGINS_GOOD=y
BR2_PACKAGE_GST1_PLUGINS_BAD=y
BR2_PACKAGE_GST1_PLUGINS_BAD_LIB_OPENGL=y
BR2_PACKAGE_GST1_PLUGINS_UGLY=y
BR2_PACKAGE_FBGRAB=y
BR2_PACKAGE_FBV=y
BR2_PACKAGE_QT5=y
BR2_PACKAGE_QT5BASE_LICENSE_APPROVED=y
BR2_PACKAGE_QT5BASE_EXAMPLES=y
BR2_PACKAGE_QT5BASE_OPENGL_LIB=y
BR2_PACKAGE_QT5BASE_LINUXFB=y
BR2_PACKAGE_QT5BASE_XCB=y
BR2_PACKAGE_QT5BASE_EGLFS=y
BR2_PACKAGE_QT5BASE_DEFAULT_QPA="eglfs"
BR2_PACKAGE_QT5BASE_FONTCONFIG=y
BR2_PACKAGE_QT5BASE_GIF=y
BR2_PACKAGE_QT5BASE_JPEG=y
BR2_PACKAGE_QT5BASE_PNG=y
BR2_PACKAGE_QT5BASE_DBUS=y
BR2_PACKAGE_QT5BASE_ICU=y
BR2_PACKAGE_QT5BASE_TSLIB=y
BR2_PACKAGE_QT5GRAPHICALEFFECTS=y
BR2_PACKAGE_QT5IMAGEFORMATS=y
BR2_PACKAGE_QT5MULTIMEDIA=y
BR2_PACKAGE_QT5QUICKCONTROLS=y
BR2_PACKAGE_QT5SERIALPORT=y
BR2_PACKAGE_QT5QUICK1=y
BR2_PACKAGE_XORG7=y
BR2_PACKAGE_XSERVER_XORG_SERVER=y
BR2_PACKAGE_XSERVER_XORG_SERVER_AIGLX=y
BR2_PACKAGE_XSERVER_XORG_SERVER_XVFB=y
BR2_PACKAGE_XLIB_LIBXCOMPOSITE=y
BR2_PACKAGE_XAPP_RSTART=y
BR2_PACKAGE_XAPP_SETXKBMAP=y
BR2_PACKAGE_XAPP_TWM=y
BR2_PACKAGE_XAPP_VIEWRES=y
BR2_PACKAGE_XAPP_XCALC=y
BR2_PACKAGE_XAPP_XCLOCK=y
BR2_PACKAGE_XAPP_XCONSOLE=y
BR2_PACKAGE_XAPP_XEV=y
BR2_PACKAGE_XAPP_XEYES=y
BR2_PACKAGE_XAPP_XINIT=y
BR2_PACKAGE_XAPP_XINPUT=y
BR2_PACKAGE_XAPP_XINPUT_CALIBRATOR=y
BR2_PACKAGE_XAPP_XLOGO=y
BR2_PACKAGE_XAPP_XMODMAP=y
BR2_PACKAGE_XAPP_XSET=y
BR2_PACKAGE_XAPP_XSETMODE=y
BR2_PACKAGE_XDRIVER_XF86_INPUT_EVDEV=y
BR2_PACKAGE_XDRIVER_XF86_INPUT_JOYSTICK=y
BR2_PACKAGE_XDRIVER_XF86_INPUT_KEYBOARD=y
BR2_PACKAGE_XDRIVER_XF86_INPUT_LIBINPUT=y
BR2_PACKAGE_XDRIVER_XF86_INPUT_MOUSE=y
BR2_PACKAGE_XDRIVER_XF86_INPUT_SYNAPTICS=y
BR2_PACKAGE_XDRIVER_XF86_INPUT_TSLIB=y
BR2_PACKAGE_XDRIVER_XF86_VIDEO_ARK=y
BR2_PACKAGE_XDRIVER_XF86_VIDEO_AST=y
BR2_PACKAGE_XDRIVER_XF86_VIDEO_CIRRUS=y
BR2_PACKAGE_XDRIVER_XF86_VIDEO_DUMMY=y
BR2_PACKAGE_XDRIVER_XF86_VIDEO_FBDEV=y
BR2_PACKAGE_XDRIVER_XF86_VIDEO_FBTURBO=y
BR2_PACKAGE_XDRIVER_XF86_VIDEO_I128=y
BR2_PACKAGE_XDRIVER_XF86_VIDEO_NEOMAGIC=y
BR2_PACKAGE_XDRIVER_XF86_VIDEO_NV=y
BR2_PACKAGE_XDRIVER_XF86_VIDEO_SILICONMOTION=y
BR2_PACKAGE_XDRIVER_XF86_VIDEO_TGA=y
BR2_PACKAGE_XDRIVER_XF86_VIDEO_TRIDENT=y
BR2_PACKAGE_XDRIVER_XF86_VIDEO_VESA=y
BR2_PACKAGE_XDRIVER_XF86_VIDEO_VOODOO=y
BR2_PACKAGE_XFONT_FONT_ADOBE_100DPI=y
BR2_PACKAGE_XFONT_FONT_ADOBE_75DPI=y
BR2_PACKAGE_XFONT_FONT_ADOBE_UTOPIA_100DPI=y
BR2_PACKAGE_XFONT_FONT_ADOBE_UTOPIA_75DPI=y
BR2_PACKAGE_XFONT_FONT_ADOBE_UTOPIA_TYPE1=y
BR2_PACKAGE_XFONT_FONT_ARABIC_MISC=y
BR2_PACKAGE_XFONT_FONT_BH_100DPI=y
BR2_PACKAGE_XFONT_FONT_BH_75DPI=y
BR2_PACKAGE_XFONT_FONT_BH_LUCIDATYPEWRITER_100DPI=y
BR2_PACKAGE_XFONT_FONT_BH_LUCIDATYPEWRITER_75DPI=y
BR2_PACKAGE_XFONT_FONT_BH_TTF=y
BR2_PACKAGE_XFONT_FONT_BH_TYPE1=y
BR2_PACKAGE_XFONT_FONT_BITSTREAM_100DPI=y
BR2_PACKAGE_XFONT_FONT_BITSTREAM_75DPI=y
BR2_PACKAGE_XFONT_FONT_BITSTREAM_TYPE1=y
BR2_PACKAGE_XFONT_FONT_CRONYX_CYRILLIC=y
BR2_PACKAGE_XFONT_FONT_DAEWOO_MISC=y
BR2_PACKAGE_XFONT_FONT_DEC_MISC=y
BR2_PACKAGE_XFONT_FONT_IBM_TYPE1=y
BR2_PACKAGE_XFONT_FONT_ISAS_MISC=y
BR2_PACKAGE_XFONT_FONT_JIS_MISC=y
BR2_PACKAGE_XFONT_FONT_MICRO_MISC=y
BR2_PACKAGE_XFONT_FONT_MISC_CYRILLIC=y
BR2_PACKAGE_XFONT_FONT_MISC_ETHIOPIC=y
BR2_PACKAGE_XFONT_FONT_MISC_MELTHO=y
BR2_PACKAGE_XFONT_FONT_MUTT_MISC=y
BR2_PACKAGE_XFONT_FONT_SCHUMACHER_MISC=y
BR2_PACKAGE_XFONT_FONT_SONY_MISC=y
BR2_PACKAGE_XFONT_FONT_SUN_MISC=y
BR2_PACKAGE_XFONT_FONT_WINITZKI_CYRILLIC=y
BR2_PACKAGE_XFONT_FONT_XFREE86_TYPE1=y
BR2_PACKAGE_XPROTO_APPLEWMPROTO=y
BR2_PACKAGE_XPROTO_DMXPROTO=y
BR2_PACKAGE_XPROTO_DRI2PROTO=y
BR2_PACKAGE_XPROTO_DRI3PROTO=y
BR2_PACKAGE_XPROTO_FONTCACHEPROTO=y
BR2_PACKAGE_XPROTO_SCRNSAVERPROTO=y
BR2_PACKAGE_XPROTO_WINDOWSWMPROTO=y
BR2_PACKAGE_XPROTO_XPROXYMANAGEMENTPROTOCOL=y
BR2_PACKAGE_XDATA_XCURSOR_THEMES=y
BR2_PACKAGE_XCURSOR_TRANSPARENT_THEME=y
BR2_PACKAGE_DILLO=y
BR2_PACKAGE_XSCREENSAVER=y
BR2_PACKAGE_XTERM=y
BR2_PACKAGE_XVKBD=y
BR2_PACKAGE_TEDGPIO_LIB=y
BR2_PACKAGE_WIRINGPI=y
BR2_PACKAGE_FLYCAPTURE2_ARM_LIB=y
BR2_PACKAGE_FLYCAPTURE_ENABLE_PASSWORD=y
BR2_PACKAGE_FLYCAPTURE2_ARM_SNAPSHOT=y
BR2_PACKAGE_SAMIA_HELPER=y
BR2_PACKAGE_RPI_FIRMWARE=y
BR2_PACKAGE_RPI_FIRMWARE_INSTALL_VCDBG=y
BR2_PACKAGE_I2C_TOOLS=y
BR2_PACKAGE_NODEJS=y
BR2_PACKAGE_NODEJS_NPM=y
BR2_PACKAGE_NODEJS_MODULES_EXPRESS=y
BR2_PACKAGE_STARTUP_NOTIFICATION=y
BR2_PACKAGE_DROPBEAR=y
BR2_PACKAGE_NTP=y
BR2_PACKAGE_NTP_NTPDATE=y
BR2_PACKAGE_UTIL_LINUX_BINARIES=y
BR2_PACKAGE_UTIL_LINUX_SETTERM=y
BR2_PACKAGE_NANO=y
BR2_TARGET_ROOTFS_EXT2=y
BR2_TARGET_ROOTFS_EXT2_4=y
BR2_TARGET_ROOTFS_EXT2_LABEL="rootfs"
BR2_PACKAGE_HOST_DOSFSTOOLS=y
BR2_PACKAGE_HOST_GENIMAGE=y
BR2_PACKAGE_HOST_MTOOLS=y
```

## package/flycapture2-arm-lib/Config.in
```kconfig
config BR2_PACKAGE_FLYCAPTURE2_ARM_LIB
	bool "Fly Capture Library for arm platform"
	depends on BR2_ARM_EABIHF
	select BR2_PACKAGE_LIBRAW1394
	select BR2_PACKAGE_LIBUSB
	help
	  Libraries required to develop your application on arm
	  platform using the FlyCapture2 SDK on Point Grey USB 2.0
	  cameras or Point Grey USB 3.0 cameras.
          
	  https://www.ptgrey.com/

comment "flycapture2-arm-lib  needs an ARM EABIHF platform"
	depends on !BR2_ARM_EABIHF

if BR2_PACKAGE_FLYCAPTURE2_ARM_LIB

config BR2_PACKAGE_USERNAME_FLYCAPTURE2
	string "username"
	default "tedpi"
	help
	 Select the username to be added to the group pgrimaging

config BR2_PACKAGE_FLYCAPTURE_ENABLE_PASSWORD
	bool "Enalbe user password"
	help
	 Enable this option to add a password to the username

if BR2_PACKAGE_FLYCAPTURE_ENABLE_PASSWORD

config BR2_PACKAGE_PASSWORD_FLYCAPTURE2
        string "password"
        default "tedpi"
        help
         Select the password to be added to the username

endif

config BR2_PACKAGE_FLYCAPTURE2_ARM_SNAPSHOT
	bool "Snapshot Fly Capture for arm platform"
	help
	  Program to take a snapshot with the FlyCapture2 SDK
	  on Point Grey USB 2.0 cameras or Point Grey USB 3.0
	  cameras.
          
endif
```

## package/tedesys/gpio-control/Config.in
```kconfig
config BR2_PACKAGE_GPIO_CONTROL
	bool "gpio-control"
	help
	  This application is an usuful tool to manage gpios.
	  You can export, unexport, read and write gpios.
          
	  https://www.tedesys.com
```

## package/tedesys/samia-helper/Config.in
```kconfig
config BR2_PACKAGE_SAMIA_HELPER
	bool "samia-helper"
	depends on BR2_PACKAGE_FLYCAPTURE2_ARM_LIB
	help
	  Helper to manage camera FL3-U3-13Y3M-C on SAMIA project

	  https://www.tedesys.com/

comment "samia-helper needs flycapture2-arm-lib package"
	depends on !BR2_PACKAGE_FLYCAPTURE2_ARM_LIB
```

## package/tedesys/tedgpio-lib/Config.in
```kconfig
config BR2_PACKAGE_TEDGPIO_LIB
	bool "gpio_control (tedgpio-lib)"
	help
	  gpio_control is an application to manage gpio on linux platform.
	  This application is an usuful tool to manage gpios.
	  You can export, unexport, read and write gpios.

	  https://www.tedesys.com
```

## package/wiringpi/Config.in
```kconfig
config BR2_PACKAGE_WIRINGPI
        bool "wiringpi"
        help
          WiringPi is a GPIO access library written in C for the
          BCM2835 used in the Raspberry Pi. It’s released under the
          GNU LGPLv3 license and is usable from C and C++ and many
          other languages with suitable wrappers (See below) It’s
          designed to be familiar to people who have used the
          Arduino “wiring” system

          http://wiringpi.com/
```
